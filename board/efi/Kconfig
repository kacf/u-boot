## board/efi/Kconfig
```kconfig
if VENDOR_EFI

config TARGET_EFI
	bool "efi"
	select CPU_V7
	help
	  This target is used for running U-Boot on top of EFI. In
	  this case EFI does the early initialisation, and U-Boot
	  takes over once the RAM, video and CPU are fully running.
	  U-Boot is loaded as an application from EFI.

source "board/efi/efi-x86/Kconfig"
source "board/efi/efi-arm/Kconfig"

endif
```

## board/efi/efi-arm/Kconfig
```kconfig
if TARGET_EFI && ARM

config SYS_BOARD
	default "efi-arm"

config SYS_VENDOR
	default "efi"

config SYS_SOC
	default "efi"

config SYS_CONFIG_NAME
	default "efi-arm"

endif
```

## configs/efi-arm_defconfig
```kconfig
CONFIG_ARM=y
# CONFIG_ARM64 is not set
# CONFIG_ARM64_SUPPORT_AARCH32 is not set
CONFIG_VENDOR_EFI=y
CONFIG_DEFAULT_DEVICE_TREE="efi"
CONFIG_TARGET_EFI=y
CONFIG_DEBUG_UART=y
CONFIG_FIT=y
CONFIG_USE_BOOTARGS=y
CONFIG_BOOTARGS="root=/dev/sdb3 init=/sbin/init rootwait ro"
CONFIG_SYS_CONSOLE_INFO_QUIET=y
CONFIG_HUSH_PARSER=y
CONFIG_CMD_BOOTM=y
# CONFIG_CMD_SOURCE is not set
# CONFIG_CMD_GPIO is not set
CONFIG_CMD_PART=y
# CONFIG_CMD_SF is not set
# CONFIG_CMD_SF_TEST is not set
# CONFIG_CMD_SPI is not set
# CONFIG_CMD_USB is not set
# CONFIG_CMD_NET is not set
CONFIG_CMD_DHCP=y
CONFIG_CMD_PING=y
CONFIG_CMD_TIME=y
CONFIG_CMD_EXT2=y
CONFIG_CMD_EXT4=y
CONFIG_CMD_EXT4_WRITE=y
CONFIG_CMD_FAT=y
CONFIG_CMD_FS_GENERIC=y
# CONFIG_MAC_PARTITION is not set
# CONFIG_ISO_PARTITION is not set
CONFIG_EFI_PARTITION=y
# CONFIG_OF_EMBED is not set
CONFIG_OF_CONTROL=y
CONFIG_DM=y
# CONFIG_DM_USB is not set
# CONFIG_DM_ETH is not set
CONFIG_DM_SERIAL=y
CONFIG_DEBUG_EFI_CONSOLE=y
CONFIG_DEBUG_UART_BASE=0
CONFIG_DEBUG_UART_CLOCK=0
CONFIG_ICH_SPI=y
CONFIG_EFI=y
# CONFIG_EFI_LOADER is not set
CONFIG_ENV_IS_IN_MMC=y
CONFIG_BOOTCOUNT_LIMIT=y
CONFIG_BOOTCOUNT_ENV=y
CONFIG_TIMER=y
# CONFIG_DISPLAY_CPUINFO is not set
# CONFIG_DISPLAY_BOARDINFO is not set
```
